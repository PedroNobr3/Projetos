## MQTT_Bidirecional/main/Kconfig.projbuild
```kconfig
menu "Configuracao MQTT do Projeto"

    config MQTT_BROKER_URI
        string "MQTT Broker URI"
        default "mqtts://SEU_CLUSTER.s1.eu.hivemq.cloud:8883"
        help
            URI do broker (com mqtts:// para TLS e porta 8883).

    config MQTT_USERNAME
        string "MQTT Username"
        default "teste"

    config MQTT_PASSWORD
        string "MQTT Password"
        default "senha"

endmenu
menu "Configuracao WiFi do Projeto"

    config WIFI_SSID
        string "WiFi SSID"
        default "minha_rede"
        help
            Nome da rede WiFi (2.4GHz).

    config WIFI_PASSWORD
        string "WiFi Password"
        default "minha_senha"
        help
            Senha da rede WiFi.

endmenu
```

## WIFI/main/Kconfig.projbuild
```kconfig
menu "Configuracao WiFi do Projeto"

    config WIFI_SSID
        string "WiFi SSID"
        default "minha_rede"
        help
            Nome da rede WiFi (2.4GHz).

    config WIFI_PASSWORD
        string "WiFi Password"
        default "minha_senha"
        help
            Senha da rede WiFi.

endmenu
```
